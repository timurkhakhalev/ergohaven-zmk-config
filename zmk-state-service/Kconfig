## zmk-state-service/Kconfig
```kconfig
config ZMK_STATE_SERVICE
    bool "Enable ZMK State Service for exposing layer and BT profile over BLE"
    default n
    depends on BT
    depends on ZMK_BLE
    depends on !ZMK_SPLIT || ZMK_SPLIT_ROLE_CENTRAL
```
